## config/west.yml
```yaml
manifest:
  remotes:
    - name: felixhudson
      url-base: https://github.com/felixhudson
  projects:
    - name: zmk-point
      remote: felixhudson
      revision: felix-point
      import: app/west.yml
  self:
    path: config
```
